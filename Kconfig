## Kconfig
```kconfig
mainmenu "Ai-Thinker AiPi-SCBB"

config SCBB_USE_BSP
    bool "Use built-in BSP (link BSP/<platform>/)"
    default n
    help
        Standalone (CMake) builds only. Link the built-in board support
        package under BSP/<SCBB_BSP_PLATFORM>/.

        Open SDK builds do not use this file: build.sh sources
        Kconfig.scbb into the application's menuconfig, and the app's
        app_config/.config is the board definition.

if SCBB_USE_BSP
    config SCBB_BSP_PLATFORM
        string "Built-in BSP platform"
        default "Ai-M6x"
        help
            Ai-M6x   - BL616/BL618 (bflb SDK)
            axk      - aithinker_dev_open_sdk middleware (aiio_*), all chips
            stm32f10x - STM32F10x (HAL)
endif

# Modules and pin assignment. Shared with the open SDK app config
# (build.sh sources this file into ./build.sh <chip> <app> menuconfig).
source "Kconfig.scbb"

menu "Output"
    config SCBB_CONFIG_HEADER_PATH
        string "scbb_config.h output path"
        default "scbb_config.h"
endmenu
```
